## output/firmware-multitarget/bluetooth-mic/PORTED_FIRMWARE/sdkconfig.defaults
```kconfig
CONFIG_IDF_TARGET="esp32"
CONFIG_BT_ENABLED=y
CONFIG_BT_CLASSIC_ENABLED=y
CONFIG_BT_HFP_ENABLE=y
CONFIG_BT_HFP_CLIENT_ENABLE=y
CONFIG_ESPTOOLPY_FLASHSIZE_4MB=y
```

## output/firmware-multitarget/carrie-brain-badge/PORTED_FIRMWARE/sdkconfig.defaults
```kconfig
CONFIG_IDF_TARGET="esp32c3"
CONFIG_ESPTOOLPY_FLASHSIZE_4MB=y
CONFIG_PARTITION_TABLE_SINGLE_APP=y
CONFIG_FREERTOS_HZ=1000
CONFIG_PM_ENABLE=y
CONFIG_PM_DFS_INIT_AUTO=y
CONFIG_ESP_CONSOLE_UART_BAUDRATE=115200
```

## output/firmware-multitarget/esp32c6-hw/PORTED_FIRMWARE/sdkconfig.defaults
```kconfig
CONFIG_IDF_TARGET="esp32c6"
CONFIG_ESPTOOLPY_FLASHSIZE_8MB=y
CONFIG_PARTITION_TABLE_SINGLE_APP=y
```

## output/firmware-multitarget/human-detector/PORTED_FIRMWARE/sdkconfig.defaults
```kconfig
CONFIG_IDF_TARGET="esp32c3"
CONFIG_ESPTOOLPY_FLASHSIZE_4MB=y
CONFIG_PARTITION_TABLE_SINGLE_APP=y
```

## output/firmware-multitarget/image-scroll/PORTED_FIRMWARE/sdkconfig.defaults
```kconfig
CONFIG_IDF_TARGET="esp32s3"
CONFIG_SPIRAM=y
CONFIG_SPIRAM_MODE_QUAD=y
CONFIG_SPIRAM_SPEED_80M=y
CONFIG_ESPTOOLPY_FLASHSIZE_4MB=y
```

## output/firmware-multitarget/pcb-clock/PORTED_FIRMWARE/sdkconfig.defaults
```kconfig
CONFIG_IDF_TARGET="esp32c3"
CONFIG_ESPTOOLPY_FLASHSIZE_4MB=y
CONFIG_PARTITION_TABLE_SINGLE_APP=y
CONFIG_ESP_WIFI_STATIC_RX_BUFFER_NUM=8
```

## public/ESP32Codes/PlatformIO/Microphones/blueToothMic/sdkconfig.defaults
```kconfig
# Flash & Partition
CONFIG_ESPTOOLPY_FLASHSIZE_4MB=y
CONFIG_PARTITION_TABLE_SINGLE_APP_LARGE=y

# Bluetooth Controller
CONFIG_BT_ENABLED=y
CONFIG_BTDM_CTRL_MODE_BR_EDR_ONLY=y
CONFIG_BTDM_CTRL_BR_EDR_SCO_DATA_PATH_HCI=y
CONFIG_BTDM_CTRL_BR_EDR_MAX_SYNC_CONN=1

# Bluedroid
CONFIG_BT_BLUEDROID_ENABLED=y
CONFIG_BT_CLASSIC_ENABLED=y

# HFP - Hands-Free Profile (this is what makes us appear as a BT mic)
CONFIG_BT_HFP_ENABLE=y
CONFIG_BT_HFP_CLIENT_ENABLE=y
CONFIG_BT_HFP_AG_ENABLE=n
CONFIG_BT_HFP_AUDIO_DATA_PATH_HCI=y
CONFIG_BT_HFP_WBS_ENABLE=y

# Secure Simple Pairing
CONFIG_BT_SSP_ENABLED=y

# Disable unused profiles to save flash
CONFIG_BT_A2DP_ENABLE=n
CONFIG_BT_SPP_ENABLED=n
CONFIG_BT_BLE_ENABLED=n
```
